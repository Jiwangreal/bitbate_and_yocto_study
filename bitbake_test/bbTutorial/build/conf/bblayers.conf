## bitbake_test/bbTutorial/build/conf/bblayers.conf
```bitbake
BBPATH := "${TOPDIR}"
BBFILES ?= ""
# BBLAYERS = "/home/wangji/ota/bitbake_test/bbTutorial/meta-tutorial"
# BBLAYERS = " \
#   ${BBPATH}/../meta-tutorial \
#   ${BBPATH}/../meta-two \
# "

BBLAYERS += "${BBPATH}/../meta-tutorial"
BBLAYERS += "${BBPATH}/../meta-two"
```
